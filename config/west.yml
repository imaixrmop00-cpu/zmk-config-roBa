## config/west.yml
```yaml
manifest:
  remotes:
    - name: zmkfirmware
      url-base: https://github.com/zmkfirmware
    - name: kumamuk-git
      url-base: https://github.com/kumamuk-git

  projects:
    - name: zmk
      remote: zmkfirmware
      revision: main
      import: app/west.yml

    - name: zmk-pmw3610-driver
      remote: kumamuk-git
      revision: main

    - name: zmk-mouse-gestures
      url: https://github.com/ZIPLAB/zmk-mouse-gestures
      revision: main

  self:
    path: config
```
